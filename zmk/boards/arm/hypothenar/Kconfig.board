## zmk/boards/arm/hypothenar/Kconfig.board
```kconfig
# SPDX-License-Identifier: MIT

config BOARD_HYPOTHENAR
    bool "Hypothenar (MS88SF3 nRF52840 module)"
    depends on SOC_NRF52840_QIAA
```

## zmk/boards/shields/hypothenar/Kconfig.shield
```kconfig
config SHIELD_HYPOTHENAR_LEFT
    def_bool $(shields_list_contains,hypothenar_left)

config SHIELD_HYPOTHENAR_RIGHT
    def_bool $(shields_list_contains,hypothenar_right)
```
