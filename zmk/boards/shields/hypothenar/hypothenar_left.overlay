// SPDX-License-Identifier: MIT
//
// Left half. Diode matrix (see hypothenar.dtsi) - left uses transform
// columns 0..5 (col-offset 0, the default). Just point the physical
// layout at the shared matrix kscan + transform and enable the encoder.

#include "hypothenar.dtsi"

&physical_layout0 {
    kscan = <&kscan_matrix>;
    transform = <&default_transform>;
};

&encoder_left {
    status = "okay";
};
