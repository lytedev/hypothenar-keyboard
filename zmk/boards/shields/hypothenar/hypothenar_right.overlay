// SPDX-License-Identifier: MIT
//
// Right half. Diode matrix (see hypothenar.dtsi) - same wiring as the
// left, but col-offset 6 lands its cells in transform columns 6..11 so
// they occupy the right-hand block of the keymap.
//
// The peripheral's columns auto-offset by the central kscan's 6 columns,
// so its cells land in transform cols 6..11 (no col-offset property -
// that isn't valid on this ZMK's kscan-gpio-matrix).
//
// BRING-UP: if the right half's columns read reversed (mirrored PCB),
// reverse col-gpios (override the whole list here). Verify on hardware -
// the class of bug the thenar hit.

#include "hypothenar.dtsi"

&physical_layout0 {
    kscan = <&kscan_matrix>;
    transform = <&default_transform>;
};

&encoder_right {
    status = "okay";
};
